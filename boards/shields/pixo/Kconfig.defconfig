## boards/shields/pixo/Kconfig.defconfig
```kconfig
if PIXO_LEFT

config ZMK_KEYBOARD_NAME
    default "Pixo"

config ZMK_SPLIT_ROLE_CENTRAL
    default y

endif

if PIXO_LEFT || PIXO_RIGHT

config ZMK_SPLIT
    default y

end
```

## boards/shields/pixo/Kconfig.shield
```kconfig
config PIXO_LEFT
    def_bool $(shields_list_contains,pixo_left)

config PIXO_RIGHT
    def_bool $(shields_list_contains,pixo_right)
```
